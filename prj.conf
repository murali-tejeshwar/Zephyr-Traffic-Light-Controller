## CMakeLists.txt
```
# Find Zephyr. This also links to Zephyr's build system 
cmake_minimum_required(VERSION 3.13.1)

# set our board 
set(BOARD nrf52840dk_nrf52840)

find_package(Zephyr)

#define project name
project(lab3)

# Add source files
target_include_directories(app PRIVATE src/inc)
FILE(GLOB SRC_FILES "src/*.c")
target_sources(app PRIVATE ${SRC_FILES})
```

## prj.conf
```kconfig
CONFIG_GPIO=y
CONFIG_NEWLIB_LIBC=y
CONFIG_NEWLIB_LIBC_FLOAT_PRINTF=y
CONFIG_ASSERT=y
CONFIG_ASSERT_LEVEL=2
```

## src/main.c
```c
#include <zephyr.h>
#include <device.h>
#include <devicetree.h>
#include <drivers/gpio.h>
#include <stdio.h>

#include "global.h"

/*
int main()
{
	while (1)
		printf("event: %d\n", getButtonEvent());

	return 0;
}
*/
```

## src/light_controller.c
```c
#include <zephyr.h>
#include <drivers/gpio.h>
#include <stdio.h>
#include <device.h>
#include <devicetree.h>

#include "global.h"

#define TRAFFIC_LIGHT_SLEEP_MS      100
#define YELLOW_PHASE_MS             5000
#define TRAFFIC_LIGHT_PRIORITY      2
#define TRAFFIC_LIGHT_STACK_SIZE    2500

typedef struct _lednode 
{
	int pin;
	int flags;
} led_t;

volatile state_t global_state = RED_S;

K_MUTEX_DEFINE(state_mutex);

inline state_t getState(void)
{
    	state_t ret; 
    
	k_mutex_lock(&state_mutex, K_FOREVER);
    
	ret = global_state;
    
	k_mutex_unlock(&state_mutex);

    	return ret;
}

inline void setState(state_t newState)
{
    	k_mutex_lock(&state_mutex, K_FOREVER);
    
	global_state = newState;
    
	k_mutex_unlock(&state_mutex);
}

/* Get LED binding info from device tree */
#define LED0_NODE 	DT_ALIAS(led0)
led_t led0 = {
	DT_GPIO_PIN(LED0_NODE, gpios),
	DT_GPIO_FLAGS(LED0_NODE, gpios)
};

#define LED1_NODE 	DT_ALIAS(led1)
led_t led1 = {
	DT_GPIO_PIN(LED1_NODE, gpios),
	DT_GPIO_FLAGS(LED1_NODE, gpios)
};

#define LED2_NODE 	DT_ALIAS(led2)
led_t led2 = {
	DT_GPIO_PIN(LED2_NODE, gpios),
	DT_GPIO_FLAGS(LED2_NODE, gpios)
};

void traffic_light_task(void)
{
    	/* All LEDs are using the same GPIO port */
	const struct device *gpio_port = device_get_binding(DT_GPIO_LABEL(LED0_NODE, gpios));
	state_t local_state;
    	PinEvent_t event;

	gpio_pin_configure(gpio_port, led0.pin, GPIO_OUTPUT_INACTIVE | led0.flags);
	gpio_pin_configure(gpio_port, led1.pin, GPIO_OUTPUT_INACTIVE | led1.flags);
	gpio_pin_configure(gpio_port, led2.pin, GPIO_OUTPUT_INACTIVE | led2.flags);

    	for (;;) {
        	local_state = getState();
        	event = getButtonEvent();
				
        	switch(local_state) {
            		case RED_S:
                		gpio_pin_set(gpio_port, led0.pin, 1);
                		if (event == GO_EVT) {
                    			setState(GREEN_S);
                    			gpio_pin_set(gpio_port, led0.pin, 0);
                		}
            		break;

            		case GREEN_S:
				gpio_pin_set(gpio_port, led2.pin, 1);
                		if (event == STOP_EVT) {
					setState(YELLOW_S);
					gpio_pin_set(gpio_port, led2.pin, 0);
				}
            		break;

            		case YELLOW_S:
                		gpio_pin_set(gpio_port, led1.pin, 1);
                		k_msleep(YELLOW_PHASE_MS);
                		setState(RED_S);
                		gpio_pin_set(gpio_port, led1.pin, 0);
            		break;
        	}

        	k_msleep(TRAFFIC_LIGHT_SLEEP_MS);
    	}
}

K_THREAD_DEFINE(traffic_thread_tid, TRAFFIC_LIGHT_STACK_SIZE, traffic_light_task, NULL, NULL, NULL, TRAFFIC_LIGHT_PRIORITY, 0, 0);
```

## src/observer.c
```c
#include <zephyr.h>
#include <device.h>
#include <sys/__assert.h>

#include "global.h"

#define OBSERVER_STACK_SIZE		2500
#define OBSERVER_POLLING_PERIOD_MS	10
#define OBSERVER_PRIORITY		0

void observer_task(void)
{
	uint32_t entry_time, exit_time, time_diff;

	while (true) {
		while (getState() != GREEN_S)
			k_msleep(OBSERVER_POLLING_PERIOD_MS);

		entry_time = k_uptime_get_32();

		while (getState() == GREEN_S)
			k_msleep(OBSERVER_POLLING_PERIOD_MS);

		exit_time = k_uptime_get_32();

		time_diff = (exit_time - entry_time) / 1000;

		__ASSERT(time_diff >= 10, "Error: The Green phase exited in %d seconds", time_diff);
	}
}

K_THREAD_DEFINE(observer_thread_tid, OBSERVER_STACK_SIZE, observer_task, NULL, NULL, NULL, OBSERVER_PRIORITY, 0, 0);
```

## src/pin_listener.c
```c
#include <zephyr.h>
#include <device.h>
#include <devicetree.h>
#include <drivers/gpio.h>
#include <stdio.h>

#include "pin_listener.h"

K_MSGQ_DEFINE(eventQueue, sizeof(PinEvent_t), EVENT_QUEUE_SIZE, 4);

#define SW0	DT_ALIAS(sw0)
#define SW1	DT_ALIAS(sw1)

static PinListener pinListeners[] = {
	{
		.label = DT_GPIO_LABEL(SW0, gpios),
		.pin = DT_GPIO_PIN(SW0, gpios),
		.flags = (GPIO_INPUT | DT_GPIO_FLAGS(SW0, gpios)),
		.status = LOW_L,
		.risingEdgeEvent = GO_EVT
    	},
    	{
		.label = DT_GPIO_LABEL(SW1, gpios),
		.pin = DT_GPIO_PIN(SW1, gpios),
		.flags = (GPIO_INPUT | DT_GPIO_FLAGS(SW1, gpios)),
		.status = LOW_L,
		.risingEdgeEvent = STOP_EVT
    	}
};

static PinListenerSet listenerSet = {
	.listeners = pinListeners,
	.num = 2,
	.pollingPeriod_ms = PIN_LISTENER_POLLING_PERIOD_MS
};

static void pollPin(PinListener *listener)
{
	int ret;

	ret = gpio_pin_get(listener->gpio, listener->pin);

	switch (listener->status) {
		case LOW_L:
			if (ret == 1)
				listener->status = RISING_L;
		break;

		case RISING_L:
			if (ret == 1)
				k_msgq_put(&eventQueue, &listener->risingEdgeEvent, K_FOREVER);
			listener->status = (ret ? HIGH_L : LOW_L);
		break;

		case HIGH_L:
			if (ret == 0)
				listener->status = FALLING_L;
		break;

		case FALLING_L:
			listener->status = (ret ? HIGH_L : LOW_L);
		break;
	}
}

static void pollPinsTask()
{
	for (int i = 0; i < listenerSet.num; i++) {
        	listenerSet.listeners[i].gpio = device_get_binding(listenerSet.listeners[i].label);
        	gpio_pin_configure(listenerSet.listeners[i].gpio, listenerSet.listeners[i].pin, (GPIO_INPUT | listenerSet.listeners[i].flags));
    	}
    
    	for (;;) {
        	for (int i = 0; i < listenerSet.num; i++)
            		pollPin(listenerSet.listeners + i);

		k_msleep(listenerSet.pollingPeriod_ms);
	}
}

PinEvent_t getButtonEvent(void)
{
	PinEvent_t pin_evt = NO_EVT;

	k_msgq_get(&eventQueue, &pin_evt, K_NO_WAIT);

	return pin_evt;
}

K_THREAD_DEFINE(pin_listener_tid, PIN_LISTENER_STACK_SIZE, pollPinsTask, NULL, NULL, NULL, PIN_LISTENER_PRIORITY, 0, 100);
```
